// File generated 1/1/2022 2:41:44 PM
// Warning! This is a generated file, any manual changes will be
// lost during the next generation.

#constant  Strings0Count    1
#constant  Strings0Size     10
#constant  Strings1Count    1
#constant  Strings1Size     3
#constant  Strings2Count    1
#constant  Strings2Size     11
#constant  Strings3Count    1
#constant  Strings3Size     5
#constant  Strings4Count    1
#constant  Strings4Size     28
#constant  Strings5Count    1
#constant  Strings5Size     68
#constant  IFONT_OFFSET     6
// object indexes into ImageControl
#CONST
    iAngularmeter0  // offset 0x0
    iStatictext0    // offset 0xA5B600
    iLeddigits0     // offset 0xA5BE00
    iiLeddigits0    // offset 0xA60800
    iLeddigits1     // offset 0xA77A00
    iiLeddigits1    // offset 0xA7CA00
    iLeddigits2     // offset 0xA8D600
    iiLeddigits2    // offset 0xA92600
    iLeddigits3     // offset 0xAA3200
    iiLeddigits3    // offset 0xAA6A00
    iLeddigits4     // offset 0xAB7E00
    iiLeddigits4    // offset 0xABB600
    iGauge0         // offset 0xACCA00
    iLeddigits5     // offset 0xC32200
    iiLeddigits5    // offset 0xC32E00
    iUserled0       // offset 0xC36800
    iUserled1       // offset 0xC37000
    iThermometer0   // offset 0xC37800
    iThermometer1   // offset 0x1246400
    iStatictext1    // offset 0x1AE4400
    iStatictext2    // offset 0x1AE4C00
    iUserbutton0    // offset 0x1AE5000
    iUserbutton1    // offset 0x1AE9200
    iLed0           // offset 0x1AF2400
#END


#constant  Strings0StartH   0x0
#constant  Strings0StartL   0x0
#constant  Strings1StartH   0x0
#constant  Strings1StartL   0x200
#constant  Strings2StartH   0x0
#constant  Strings2StartL   0x400
#constant  Strings3StartH   0x0
#constant  Strings3StartL   0x600
#constant  Strings4StartH   0x0
#constant  Strings4StartL   0x800
#constant  Strings5StartH   0x0
#constant  Strings5StartL   0xA00

#IFNOT EXISTS NOGLOBALS
var hndl ;
var hFonts[6] ;
#ENDIF
